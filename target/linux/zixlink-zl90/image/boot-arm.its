## target/linux/zixlink-zl90/image/boot-arm.its
```
/*
 * Copyright (C) 2021 Rockchip Electronics Co., Ltd
 *
 * SPDX-License-Identifier: GPL-2.0
 */

/dts-v1/;
/ {
    description = "FIT image with Linux kernel, FDT blob and resource";

    images {
        fdt {
            data = /incbin/("fdt");
            type = "flat_dt";
            arch = "arm";
            compression = "none";
            load = <0x01000000>;

            hash {
                algo = "sha256";
            };
        };

        kernel {
            data = /incbin/("kernel");
            type = "kernel";
            arch = "arm";
            os = "linux";
            compression = "none";
            entry = <0x00008000>;
            load = <0x00008000>;

            hash {
                algo = "sha256";
            };
        };
        
        ramdisk {
            description = "RootFS";
            data = /incbin/("ramdisk");
            type = "ramdisk";
            arch = "arm";
            os = "linux";
            compression = "none";
            load = <0x001100000>;
            hash {
                algo = "sha256";
            };
        };

        resource {
            data = /incbin/("resource");
            type = "multi";
            arch = "arm";
            compression = "none";

            hash {
                algo = "sha256";
            };
        };
    };

    configurations {
        default = "conf";

        conf {
            rollback-index = <0x00>;
            fdt = "fdt";
            kernel = "kernel";
            ramdisk = "ramdisk";
            multi = "resource";

            signature {
                algo = "sha256,rsa2048";
                padding = "pss";
                key-name-hint = "dev";
                sign-images = "fdt", "kernel", "ramdisk", "multi";
            };
        };
    };
};
```
